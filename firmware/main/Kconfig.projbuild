## firmware/main/Kconfig.projbuild
```kconfig
menu "Comma firmware"
choice COMMA_BOARD
    prompt "Board"
    default COMMA_BOARD_ESP32_DEVKIT if IDF_TARGET_ESP32
    default COMMA_BOARD_T_CIRCLE_S3
config COMMA_BOARD_T_CIRCLE_S3
    bool "LilyGO T-Circle-S3"
    depends on IDF_TARGET_ESP32S3
config COMMA_BOARD_ESP32_DEVKIT
    bool "ESP32 DevKit (no PSRAM)"
    depends on IDF_TARGET_ESP32
config COMMA_BOARD_WAVESHARE_AMOLED_1_32
    bool "Waveshare ESP32-S3-Touch-AMOLED-1.32 (build with tools/board.sh)"
    depends on IDF_TARGET_ESP32S3
config COMMA_BOARD_M5STACK_STICKS3
    bool "M5Stack StickS3 (build with tools/board.sh)"
    depends on IDF_TARGET_ESP32S3
config COMMA_BOARD_WAVESHARE_AMOLED_1_43C
    bool "Waveshare ESP32-S3-Touch-AMOLED-1.43C (build with tools/board.sh)"
    depends on IDF_TARGET_ESP32S3
endchoice
config COMMA_BOARD_ID
    string
    default "t-circle-s3" if COMMA_BOARD_T_CIRCLE_S3
    default "esp32-devkit" if COMMA_BOARD_ESP32_DEVKIT
    default "waveshare-amoled-1-32" if COMMA_BOARD_WAVESHARE_AMOLED_1_32
    default "m5stack-sticks3" if COMMA_BOARD_M5STACK_STICKS3
    default "waveshare-amoled-1-43c" if COMMA_BOARD_WAVESHARE_AMOLED_1_43C
config COMMA_CLIENT_SOURCE
    string
    default "t-circle" if COMMA_BOARD_T_CIRCLE_S3
    default "esp32-devkit" if COMMA_BOARD_ESP32_DEVKIT
    default "waveshare-amoled-1-32" if COMMA_BOARD_WAVESHARE_AMOLED_1_32
    default "m5stack-sticks3" if COMMA_BOARD_M5STACK_STICKS3
    default "waveshare-amoled-1-43c" if COMMA_BOARD_WAVESHARE_AMOLED_1_43C
config COMMA_HAS_VOICE
    bool "Voice"
    default y if COMMA_BOARD_T_CIRCLE_S3 || COMMA_BOARD_M5STACK_STICKS3 || COMMA_BOARD_WAVESHARE_AMOLED_1_43C
    help
        Needs a mic and a speaker. The Waveshare AMOLED 1.32 has no speaker on board (only a header);
        the 1.43C has an amplifier and a speaker connector.
config COMMA_HAS_DISPLAY
    bool "Display"
    default y if COMMA_BOARD_T_CIRCLE_S3 || COMMA_BOARD_WAVESHARE_AMOLED_1_32 || COMMA_BOARD_M5STACK_STICKS3 || \
                 COMMA_BOARD_WAVESHARE_AMOLED_1_43C
config COMMA_DISPLAY_SIZE
    int "Round screen size in pixels"
    depends on COMMA_HAS_DISPLAY && !COMMA_BOARD_M5STACK_STICKS3
    default 466 if COMMA_BOARD_WAVESHARE_AMOLED_1_32 || COMMA_BOARD_WAVESHARE_AMOLED_1_43C
    default 160
    help
        Cards and the logo are drawn for this size; ui/<size>/ holds its fonts and logo.
config COMMA_DISPLAY_WIDTH
    int "Rectangular screen width in pixels"
    depends on COMMA_HAS_DISPLAY && COMMA_BOARD_M5STACK_STICKS3
    default 135
config COMMA_DISPLAY_HEIGHT
    int "Rectangular screen height in pixels"
    depends on COMMA_HAS_DISPLAY && COMMA_BOARD_M5STACK_STICKS3
    default 240
    help
        Cards and the logo are drawn for WIDTH x HEIGHT; ui/<width>x<height>/ holds its fonts and logo.
config COMMA_BOOT_PRESS_CALLS
    bool "A short BOOT press starts or ends a call, like a tap"
    depends on COMMA_HAS_VOICE
    default n
    help
        A press released before the 3 s pairing hold is the call key. Holds keep their meaning.
config COMMA_PAIRING_PASSKEY
    bool "Pair with display passkey and MITM protection"
    default y if COMMA_BOARD_T_CIRCLE_S3 || COMMA_BOARD_WAVESHARE_AMOLED_1_32 || COMMA_BOARD_M5STACK_STICKS3 || \
                 COMMA_BOARD_WAVESHARE_AMOLED_1_43C
config COMMA_LAN_DISCOVER
    bool "LAN discovery"
    default y
config COMMA_FREE_BLE_FOR_DISCOVERY
    bool "End setup BLE soon after connector_up; discovery waits for BLE off"
    default n
    help
        For boards without PSRAM, where setup BLE holds the memory a discovery result needs.
        After connector_up has been notified over BLE, setup ends BLE 3 s later instead of
        waiting for the app to disconnect. A lan_discover that arrives while BLE is still on
        waits for it to end (at most 10 s, within the backend's request deadline) before it
        allocates anything; then it runs either way.
config COMMA_HEAP_DIAGNOSTICS
    bool "Log heap and task stack measurements"
    default n
config COMMA_LAN_HTTP_MAX_BYTES
    int "Maximum text HTTP body"
    range 1024 65536
    default 65536
config COMMA_LAN_HTTP_CHUNK_BYTES
    int "Maximum raw HTTP chunk"
    range 512 32768
    default 32768
config COMMA_LAN_HTTP_CHUNK_FRAME_BYTES
    int "Raw HTTP chunk with writable socket gate"
    range 512 8192
    default 8192
config COMMA_CONNECTOR_RX_MAX
    int "Maximum incoming Connector JSON frame"
    range 2048 73728
    default 73728
config COMMA_LAN_DISCOVER_ARENA_BYTES
    int "Discovery string arena"
    range 1024 98304
    default 98304
config COMMA_LAN_DISCOVER_MAX_SERVICES
    int "Maximum discovery services per host"
    range 1 16
    default 16
    help
        Additional services are omitted and set truncated=true.
config COMMA_LAN_DISCOVER_MAX_SSDP
    int "Maximum discovery SSDP entries per host"
    range 1 16
    default 16
    help
        Additional SSDP entries are omitted and set truncated=true.
config COMMA_LAN_DISCOVER_MAX_JSON
    int "Maximum discovery result JSON bytes"
    range 1024 49152
    default 49152
    help
        Limit the result and its buffer growth (plus one byte for the NUL).
        Hosts that do not fit are omitted and set truncated=true.
config COMMA_LAN_DISCOVER_PROBES
    int "Maximum UDP discovery probes per call"
    range 0 8
    default 8
    help
        Zero disables probes and omits discover_probes from metadata.
config COMMA_LAN_DISCOVER_PROBE_PAYLOAD
    int "Maximum decoded discovery probe payload"
    range 1 512
    default 512
config COMMA_LAN_DISCOVER_PROBE_ANSWER
    int "Maximum stored bytes per discovery probe answer"
    range 1 1024
    default 1024
config COMMA_LAN_DISCOVER_PROBE_BUDGET
    int "Total decoded discovery probe answer budget"
    range 1 16384
    default 16384
config COMMA_LAN_UDP_MAX_ANSWER
    int "Maximum UDP answer"
    range 512 4096
    default 4096
config COMMA_LAN_TUNNELS
    int "Concurrent TCP tunnels"
    range 0 2
    default 2
config COMMA_LAN_TUNNEL_WINDOW
    int "Tunnel window (server requires at least 32 KiB)"
    range 32768 131072
    default 131072
config COMMA_LAN_TUNNEL_MAX_FRAME
    int "Raw device to server tunnel frame"
    range 512 8192
    default 8192
config COMMA_CONNECTOR_WS_BUFFER_SIZE
    int "WebSocket client read/write buffer"
    range 1024 4096
    default 4096
config COMMA_LED_GPIO
    int "Status LED GPIO (-1 disables)"
    range -1 33
    default -1
config COMMA_BOOT_GPIO
    int "BOOT GPIO (active low)"
    range 0 39
    default 0
endmenu
```
